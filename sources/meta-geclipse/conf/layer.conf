## sources/meta-geclipse/conf/layer.conf
```bitbake
# We have a conf and classes directory, add to BBPATH
BBPATH .= ":${LAYERDIR}"

# We have a packages directory, add to BBFILES
BBFILES += "${LAYERDIR}/recipes-*/*/*.bb \
            ${LAYERDIR}/recipes-*/*/*.bbappend \
            ${LAYERDIR}/recipes-*/*.bb \
            ${LAYERDIR}/recipes-*/*.bbappend \
            "

BBFILE_COLLECTIONS += "geclipse"
BBFILE_PATTERN_geclipse := "^${LAYERDIR}/"
BBFILE_PRIORITY_geclipse = "4"
LAYERVERSION_geclipse = "1"
```
